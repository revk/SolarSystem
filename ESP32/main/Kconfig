## ESP32/main/Kconfig
```kconfig
menu "SS"

        config NFC_BAUD_CODE
        int "NFC reader baud rate code"
        default 4
        help
                Set 0-8 for 9600 to 1288000 bps

endmenu
```

## Kconfig
```kconfig
menu "SolarSystem web control"


menu "MQTT"

    config MQTT_HOSTNAME
    string "MQTT hostname - needs to match domain name for certificates to work"
    default ""
    help
   	Set the hostname used for your server

    config MQTT_PORT
    string "MQTT TCP port (name or number)"
    default "8883"
    help
   	The TCP port you listen to

    config MQTT_INSECURE_PORT
    string "MQTT TCP port (name or number) for initial insecure connection"
    default "1883"
    help
   	The TCP port you listen to

    config MQTT_IPV4
    bool "MQTT Bind only to IPv4 "

endmenu

menu "SQL"

    config SQL_SERVER_FILE
    string "SQL config file for server user"
    default ""
    help
    	SQL connection configuration file for access to SS and SSKey databases

    config SQL_WEBUSER_FILE
    string "SQL config file for user (apache)"
    default ""
    help
    	SQL connection configuration file for access to SS database only
	This should be the same as DB_CONF in login config

    config SQL_DATABASE
    string "SQL database"
    default "SS"
    help
    	SQL database name for main data
	This should be the same as DB_DATABASE in login config

    config SQL_KEY_DATABASE
    string "SQL database"
    default "SSKey"
    help
    	SQL database name for AES keys

    config SQL_DEBUG
    bool "SQL debug"
    default n
    help
    	SQL debug

endmenu

    config OTA_HOSTNAME
    string "OTA hostname"
    default "ota.revk.uk"
    help
  	The default OTA host name for device upgrade

    config KEYS_FILE
    string "Filename for keys"
    default "solarsystem.keys"
    help
    	Filename for CA/MQTT keys

    config MSG_KEY_FILE
    string "Filename for internal messaging key"
    default "message.keys"
    help
    	Filename message command internal keys

endmenu
```
